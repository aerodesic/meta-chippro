## conf/layer.conf
```bitbake
# We have a conf and classes directory, add to BBPATH
BBPATH .= ":${LAYERDIR}"

# We have a recipes-* directories, add to BBFILES
BBFILES += "${LAYERDIR}/recipes-*/*/*.bb \
    ${LAYERDIR}/recipes-*/*/*.bbappend"

BBFILE_COLLECTIONS += "meta-chippro"
BBFILE_PATTERN_meta-chippro = "^${LAYERDIR}/"
BBFILE_PRIORITY_meta-chippro = "6"

# Add this to get access to sunxi-tools recipe
LAYERDEPENDS_meta-chippro = "meta-sunxi"
```

## conf/machine/chippro.conf
```bitbake
#@TYPE: Machine
#@NAME: C.H.I.P. board
#@DESCRIPTION: Machine configuration for C.H.I.P. board

MACHINE_EXTRA_RRECOMMENDS += " kernel-modules packagegroup-base"
MACHINE_ESSENTIAL_EXTRA_RDEPENDS += " kernel-image kernel-devicetree"

EXTRA_IMAGEDEPENDS += "u-boot sunxi-tools-native android-tools-native"

# TARGET_CFLAGS += "-v"

DEFAULTTUNE ?= "cortexa8t-neon"
include conf/machine/include/tune-cortexa8.inc


SERIAL_CONSOLE = "115200 ttyS0"

PREFERRED_PROVIDER_virtual/kernel ?= "linux-chippro"
PREFERRED_PROVIDER_u-boot ?= "u-boot-chip"
PREFERRED_RPROVIDER_initd-functions ?= "lsbinitscripts"

KERNEL_IMAGETYPE = "zImage"
KERNEL_DEVICETREE = "ntc-gr8-crumb.dtb"

SPL_BINARY = "u-boot-sunxi-with-spl.bin"
# SPL_BINARY = "sunxi-spl.bin"
SPL_ECC_BINARY = "sunxi-spl-with-ecc.bin"
UBOOT_BINARY = "u-boot-dtb.bin"
UBOOT_MACHINE = "CHIP_pro_defconfig"
# UBOOT_ENV = "u-boot-env"
UBOOT_ENV_NAME = "u-boot-env.bin"
MAX_UBI_SIZE = "(512 << 10)"
NAND_ERASE_BLOCK_SIZE = "262144"
export NAND_OOB_SIZE = "256"
export NAND_PAGE_SIZE = "4096"
export NAND_SPL_USABLE_PAGE_SIZE = "1024"
# export NAND_LEB_SIZE = "$((${NAND_ERASE_BLOCK_SIZE}-${NAND_PAGE_SIZE}))"
export NAND_LEB_SIZE = "258048"

MACHINE_FEATURES = "usbgadget usbhost wifi"

# Include wifi modules and firmware
MACHINE_EXTRA_RRECOMMENDS += "kernel-module-r8723bs"

IMAGE_FSTYPES += "ubimultivol"
MKUBIFS_ARGS = "--min-io-size=${NAND_PAGE_SIZE} --leb-size=${NAND_LEB_SIZE} --max-leb-cnt=2048 -F"
UBINIZE_ARGS = "--min-io-size=${NAND_PAGE_SIZE} --peb-size=${NAND_ERASE_BLOCK_SIZE} --sub-page-size=${NAND_SPL_USABLE_PAGE_SIZE} -O 2048"

ENV_IMAGE_SIZE = "0x200000"
UBI_ECC_HEADER = "2048"
UBI_BOOT_ROOTFS = "rootfs"
UBI_BOOT_FDT = "fdt"
UBI_PART = "UBI"
UBOOT_INSTALL_FILE = "u-boot-padded-${MACHINE}.bin"
SPL_INSTALL_FILE = "spl-padded-${MACHINE}.bin"

# Addresses within ram to receive flashable bits
export SPL_MEM_ADDR = "0x43000000"
export UBOOT_MEM_ADDR = "0x4a000000"
export UBOOT_SCRIPT_ADDR = "0x43100000"
export UBOOT_SCRIPT_BASE_NAME = "u-boot-flash"

export UBIVOL_NAMES		= "${UBI_BOOT_ROOTFS}"

export UBIVOL_IMAGE_rootfs	= "<rootfs>"
export UBIVOL_NAME_rootfs	= "${UBI_BOOT_ROOTFS}"
export UBIVOL_TYPE_rootfs	= "dynamic"
export UBIVOL_FLAGS_rootfs	= "autoresize"

export UBIVOL_SPARSE		= "yes"
```
